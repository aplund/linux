## Documentation/devicetree/bindings/rtc/rtc-meson-vrtc.txt
```
* Amlogic Virtual RTC (VRTC)

This is a Linux interface to an RTC managed by firmware, hence it's
virtual from a Linux perspective.  The interface is 1 register where
an alarm time is to be written.

Required properties:
- compatible: should be "amlogic,meson-vrtc"
- reg: physical address for the alarm register

Example:

	vrtc: rtc@0a8 {
		compatible = "amlogic,meson-vrtc";
		reg = <0x0 0x000a8 0x0 0x4>;
	};
```
